## toolchain/binutils/Config.in
```kconfig
# Choose binutils version.

choice
	prompt "Binutils Version" if TOOLCHAINOPTS
	default BINUTILS_VERSION_LINARO
	default BINUTILS_VERSION_LINARO_2_25
	help
	  Select the version of binutils you wish to use.

	config BINUTILS_VERSION_LINARO
		bool "Linaro binutils 2.24"

	config BINUTILS_VERSION_LINARO_2_25
		bool "Linaro binutils 2.25"

endchoice

config EXTRA_BINUTILS_CONFIG_OPTIONS
	string
	prompt "Additional binutils configure options" if TOOLCHAINOPTS
	default ""
	help
	    Any additional binutils options you may want to include....

config BINUTILS_VERSION
	string
	prompt "Binutils Version" if (TOOLCHAINOPTS && NULL)
	default "linaro"          if BINUTILS_VERSION_LINARO
	default "linaro-2.25"     if BINUTILS_VERSION_LINARO_2_25
	default "linaro"
```

## toolchain/uClibc/Config.in
```kconfig
# Choose uclibc version.

choice
	prompt "uClibc Version"
	depends on TOOLCHAINOPTS && USE_UCLIBC
	default UCLIBC_USE_VERSION_0_9_33
	help
	  Select the version of uClibc you wish to use.

	config UCLIBC_USE_VERSION_0_9_33
		select UCLIBC_VERSION_0_9_33
		bool "uClibc 0.9.33.2"

	config UCLIBC_USE_VERSION_SNAPSHOT
		select UCLIBC_VERSION_SNAPSHOT
		bool "uClibc snapshot (2015-06-15)"

endchoice

# Debug version.

config UCLIBC_ENABLE_DEBUG
	bool "Build with debug information"
	depends on TOOLCHAINOPTS && USE_UCLIBC
	default n
```
